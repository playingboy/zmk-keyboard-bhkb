## boards/shields/bhkb/Kconfig.defconfig
```kconfig
if SHIELD_BHKB

# Name must be less than 16 characters long!
config ZMK_KEYBOARD_NAME
    default "bhkb"

endif

if ZMK_DISPLAY

config I2C
    default y

config SSD1306
    default y

endif # ZMK_DISPLAY
```

## boards/shields/bhkb/Kconfig.shield
```kconfig
# Copyright (c) 2020 Pete Johanson
# SPDX-License-Identifier: MIT

config SHIELD_BHKB
    def_bool $(shields_list_contains,bhkb)
```
